## Kconfig
```kconfig
config CYGNUS_GESTURE
    bool "Cygnus N/D/M/R trackball gesture support"
    default y
    depends on ZMK_MOUSE
    help
      Enables the host-aware Cygnus trackball gesture behavior and input processor.
```

## config/Kconfig
```kconfig
config CYGNUS_GESTURE
    bool "Cygnus trackball gesture support"
    default y
    depends on ZMK_MOUSE
    help
      Enables the Cygnus N/D/M trackball gesture behavior and input processor.
```

## config/dts/bindings/input_processors/zmk,input-processor-cygnus-gesture.yaml
```yaml
description: Cygnus trackball gesture input processor

compatible: "zmk,input-processor-cygnus-gesture"

include: ip_zero_param.yaml

properties: {}
```

## dts/bindings/behaviors/zmk,behavior-cygnus-gesture.yaml
```yaml
description: Cygnus trackball gesture key behavior

compatible: "zmk,behavior-cygnus-gesture"

include: one_param.yaml

properties:
  threshold:
    type: int
    default: 70
  ratio-numerator:
    type: int
    default: 13
  ratio-denominator:
    type: int
    default: 10
  win-layer:
    type: int
    required: true
  bindings:
    type: phandle-array
    required: true
```

## dts/bindings/input_processors/cygnus,input-processor-gesture.yaml
```yaml
description: Cygnus trackball gesture input processor

compatible: "cygnus,input-processor-gesture"

properties:
  "#input-processor-cells":
    type: int
    required: true
    const: 0
  track-remainders:
    type: boolean
  tick:
    type: int
    default: 18
  wait-ms:
    type: int
    default: 20
  tap-ms:
    type: int
    default: 20
  bindings:
    type: phandle-array
    required: true
```
